#include <Arduino.h>
#include "Wire.h"
#include <WiFi.h>
#include <Adafruit_GFX.h>
#include <Adafruit_SSD1306.h>
#include <Adafruit_I2CDevice.h>

const char* ssid = "ESP-32-AI";
const char* password = "12345678912345";

#define SPIN_1 32
#define SPIN_2 33

WiFiServer server(12345);  

const int frequency = 2000;
const int pwm_channel1 = 2;
const int resolution = 8;     
const int pwm_channel2 = 3;

int  right_speed;
int left_speed;

#define SCREEN_WIDTH 128 
#define SCREEN_HEIGHT 64

Adafruit_SSD1306 display(SCREEN_WIDTH, SCREEN_HEIGHT, &Wire, -1);

static const unsigned char PROGMEM forward_image[1024] = {
 0x00, 0x00, 0x00, 0x00, 0x00, 0x00, 0x00, 0x00, 
    0x00, 0x00, 0x00, 0x00, 0x00, 0x00, 0x00, 0x00, 
    0x00, 0x00, 0x00, 0x00, 0x00, 0x00, 0x00, 0x00, 
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    0x00, 0x00, 0x00, 0x00, 0x00, 0x00, 0x00, 0x00
};

static const unsigned char PROGMEM left_image[1024] = {
  0x00, 0x00, 0x00, 0x00, 0x00, 0x00, 0x00, 0x00, 0x00, 0x00, 0x00, 0x00, 0x00, 0x00, 0x00, 0x00, 
    0x00, 0x00, 0x00, 0x00, 0x00, 0x00, 0x00, 0x00, 0x00, 0x00, 0x00, 0x00, 0x00, 0x00, 0x00, 0x00, 
    0x00, 0x00, 0x00, 0x00, 0x00, 0x00, 0x00, 0x00, 0x00, 0x00, 0x00, 0x00, 0x00, 0x00, 0x00, 0x00, 
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    0x00, 0x00, 0x00, 0x00, 0x00, 0x00, 0x00, 0x00, 0x00, 0x00, 0x00, 0x00, 0x00, 0x00, 0x00, 0x00
};

static const unsigned char PROGMEM right_image[1024] = {
    0x00, 0x00, 0x00, 0x00, 0x00, 0x00, 0x00, 0x00, 0x00, 0x00, 0x00, 0x00, 0x00, 0x00, 0x00, 0x00, 
    0x00, 0x00, 0x00, 0x00, 0x00, 0x00, 0x00, 0x00, 0x00, 0x00, 0x00, 0x00, 0x00, 0x00, 0x00, 0x00, 
    0x00, 0x00, 0x00, 0x00, 0x00, 0x00, 0x00, 0x00, 0x00, 0x00, 0x00, 0x00, 0x00, 0x00, 0x00, 0x00, 
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    0x00, 0x00, 0x00, 0x00, 0x00, 0x00, 0x00, 0x00, 0x00, 0x00, 0x00, 0x00, 0x00, 0x00, 0x00, 0x00
};

static const unsigned char PROGMEM stop_image[1024] = {
      0x00, 0x00, 0x00, 0x00, 0x00, 0x00, 0x00, 0x00, 
    0x00, 0x00, 0x00, 0x00, 0x00, 0x00, 0x00, 0x00, 
    0x00, 0x00, 0x00, 0x00, 0x00, 0x00, 0x00, 0x00, 
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    0x00, 0x00, 0x00, 0x00, 0x00, 0x00, 0x00, 0x00
};

static const unsigned char PROGMEM spin_image[1024] = {
  0x00, 0x00, 0x00, 0x00, 0x00, 0x00, 0x00, 0x00, 0x00, 0x00, 0x00, 0x00, 0x00, 0x00, 0x00, 0x00, 
    0x00, 0x00, 0x00, 0x00, 0x00, 0x00, 0x00, 0x00, 0x00, 0x00, 0x00, 0x00, 0x00, 0x00, 0x00, 0x00, 
    0x00, 0x00, 0x00, 0x00, 0x00, 0x00, 0x00, 0x00, 0x00, 0x00, 0x00, 0x00, 0x00, 0x00, 0x00, 0x00, 
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    0x00, 0x00, 0x00, 0x00, 0x00, 0x00, 0x00, 0x00, 0x00, 0x00, 0x00, 0x00, 0x00, 0x00, 0x00, 0x00
};

static const unsigned char PROGMEM speed_up[1024] = {
  0x00, 0x00, 0x00, 0x00, 0x00, 0x00, 0x00, 0x00, 0x00, 0x00, 0x00, 0x00, 0x00, 0x00, 0x00, 0x00, 
    0x00, 0x00, 0x00, 0x00, 0x00, 0x00, 0x00, 0x00, 0x00, 0x00, 0x00, 0x00, 0x00, 0x00, 0x00, 0x00, 
    0x00, 0x00, 0x00, 0x00, 0x00, 0x00, 0x00, 0x00, 0x00, 0x00, 0x00, 0x00, 0x00, 0x00, 0x00, 0x00, 
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    0x00, 0x00, 0x00, 0x00, 0x00, 0x00, 0x00, 0x00, 0x00, 0x00, 0x00, 0x00, 0x00, 0x00, 0x00, 0x00
};

static const unsigned char PROGMEM slow_down[1024] = {
  0x00, 0x00, 0x00, 0x00, 0x00, 0x00, 0x00, 0x00, 0x00, 0x00, 0x00, 0x00, 0x00, 0x00, 0x00, 0x00, 
    0x00, 0x00, 0x00, 0x00, 0x00, 0x00, 0x00, 0x00, 0x00, 0x00, 0x00, 0x00, 0x00, 0x00, 0x00, 0x00, 
    0x00, 0x00, 0x00, 0x00, 0x00, 0x00, 0x00, 0x00, 0x00, 0x00, 0x00, 0x00, 0x00, 0x00, 0x00, 0x00, 
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    0x00, 0x00, 0x00, 0x00, 0x00, 0x00, 0x00, 0x00, 0x00, 0x00, 0x00, 0x00, 0x00, 0x00, 0x00, 0x00
};


void MoveForward(){
  right_speed = 150;
  left_speed = 145;
  ledcWrite(pwm_channel1, right_speed);   
  ledcWrite(pwm_channel2, left_speed);
  display.clearDisplay();
  display.drawBitmap(0, 0, forward_image, 128, 64, 1);
  display.display();
}

void MoveLeft(){
  right_speed = 150;
  left_speed = 100;
  ledcWrite(pwm_channel1, right_speed);   
  ledcWrite(pwm_channel2, left_speed);
  display.clearDisplay();
  display.drawBitmap(0, 0, left_image, 128, 64, 1);
  display.display();
}

void MoveRight(){
  right_speed = 100;
  left_speed = 150;
  ledcWrite(pwm_channel1, right_speed);   
  ledcWrite(pwm_channel2, left_speed);
  display.clearDisplay();
  display.drawBitmap(0, 0, right_image, 128, 64, 1);
  display.display();
}

void SpeedUp(){
  right_speed = min(right_speed + 10, 255);
  left_speed = min(left_speed + 10, 255);
  ledcWrite(pwm_channel1, right_speed);   
  ledcWrite(pwm_channel2, left_speed);
    display.clearDisplay();
  display.drawBitmap(0, 0, speed_up, 128, 64, 1);
  display.display();
}

void SpeedDown(){
  right_speed = max(right_speed - 10, 0);
  left_speed = max(left_speed - 10, 0);
  ledcWrite(pwm_channel1, right_speed);   
  ledcWrite(pwm_channel2, left_speed);
  display.clearDisplay();
  display.drawBitmap(0, 0, slow_down ,128, 64, 1);
  display.display();
}

void Stop(){
  right_speed = 0;
  left_speed = 0;
  ledcWrite(pwm_channel1, right_speed);  
  ledcWrite(pwm_channel2, left_speed);
  display.clearDisplay();
  display.drawBitmap(0, 0, stop_image, 128, 64, 1);
  display.display();
}

void Spin(){
  right_speed = 150;
  left_speed = 0;
  ledcWrite(pwm_channel1, right_speed);   
  ledcWrite(pwm_channel2, left_speed);
  display.clearDisplay();
  display.drawBitmap(0, 0, spin_image, 128, 64, 1);
  display.display();
}

void setup() {
  Serial.begin(115200);

  pinMode(SPIN_1, OUTPUT);
  pinMode(SPIN_2, OUTPUT); 
  ledcSetup(pwm_channel1, frequency, resolution);
  ledcSetup(pwm_channel2, frequency, resolution);  
  ledcAttachPin(SPIN_1, pwm_channel1);
  ledcAttachPin(SPIN_2, pwm_channel2);

  WiFi.mode(WIFI_AP);         
  WiFi.softAP(ssid, password); 
  Serial.println("\nConnected! IP address: " + WiFi.softAPIP().toString());
  server.begin();

  if(!display.begin(SSD1306_SWITCHCAPVCC, 0x3C)) {
    Serial.println(F("SSD1306 allocation failed"));
    for(;;);
  }

  delay(2000);
  display.clearDisplay();
  display.setTextSize(1);
  display.setTextColor(WHITE);
  display.setCursor(0, 10);
  display.println("Hello, world!");
  display.display(); 

}

void loop() {

    WiFiClient client = server.available();
      if (client) 
          Serial.println("Client connected!");
      while( client.connected()){
        if (client.available()) {
          String request = client.readStringUntil('\r');
          Serial.println(request);
          if (request.indexOf("spin") != -1){
            Spin();
          }
          else if (request.indexOf("stop") != -1){
            Stop();
          }
          else if (request.indexOf("forward") != -1){
            MoveForward();
          }
          else if (request.indexOf("left") != -1){
            MoveLeft();
          }
          else if (request.indexOf("right") != -1){
            MoveRight();
          }
          else if (request.indexOf("speedup") != -1){
            SpeedUp();
          }
          else if (request.indexOf("slowdown") != -1){
            SpeedDown();
          }
        }
    }

  }





